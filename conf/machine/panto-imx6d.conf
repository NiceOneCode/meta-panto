## conf/machine/panto-imx6d.conf
```bitbake
#@TYPE: Machine
#@NAME: iCoreM6 Dual
#@SOC: i.MX6D
#@DESCRIPTION: Machine configuration for iCoreM6 Dual

include conf/machine/include/iCoreM6.inc

UBINIZE_ARGS = "-m 2048 -p 128KiB -s 2048"
MKUBIFS_ARGS = "-m 2048 -e 126976 -c 1944"
UBI_VOLNAME = "rootfs"

SOC_FAMILY = "mx6:mx6q"

# KERNEL_DEVICETREE = "imx6d-emmc.dtb"

PREFERRED_PROVIDER_virtual/kernel =  "linux-n1c"

UBOOT_CONFIG[sd] = "icoremx6qd_panto_sd_defconfig, sdcard"
#UBOOT_CONFIG[nand] = "icoremx6qd_panto_nand_defconfig, ubifs"
UBOOT_CONFIG[emmc] = "icoremx6qd_panto_emmc_defconfig, sdcard"


#  KERNEL_DEVICETREE = " icoremx6q-starterkit.dtb"
KERNEL_DEVICETREE = "panto-imx6d.dtb"

IMAGE_FSTYPES = "ubifs sdcard tar.bz2"
KERNEL_DEFCONFIG = "icoremx6_defconfig"
SERIAL_CONSOLE = "115200 ttymxc0"
```

## recipes-bsp/u-boot-eng/u-boot-eng/icoremx6qd_panto_emmc_defconfig
```kconfig
CONFIG_ARM=y
CONFIG_ARCH_MX6=y
CONFIG_TARGET_ICOREM6=y
CONFIG_BOOTDELAY=1
CONFIG_HUSH_PARSER=y
CONFIG_CMD_BOOTZ=y
CONFIG_CMD_MMC=y
CONFIG_CMD_I2C=y
CONFIG_CMD_USB=y
CONFIG_CMD_GPIO=y
CONFIG_CMD_DHCP=y
CONFIG_CMD_MII=y
CONFIG_CMD_PING=y
CONFIG_CMD_CACHE=y
CONFIG_CMD_EXT2=y
CONFIG_CMD_EXT4=y
CONFIG_CMD_EXT4_WRITE=y
CONFIG_CMD_FAT=y
CONFIG_CMD_FS_GENERIC=y
CONFIG_USB=y
CONFIG_CI_UDC=y
CONFIG_G_DNL_MANUFACTURER="FSL"
CONFIG_G_DNL_VENDOR_NUM=0x0525
CONFIG_G_DNL_PRODUCT_NUM=0xa4a5
CONFIG_OF_LIBFDT=y
CONFIG_CMD_MEMTEST=y
```
